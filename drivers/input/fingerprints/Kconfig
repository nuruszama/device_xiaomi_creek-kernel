## drivers/input/fingerprints/Kconfig
```kconfig
#
# FingerprintCard fingerprint driver
#
menu "FingerprintCard fingerprint driver"
config INPUT_FINGERPRINT
       tristate "support driver fingerprint"
       default n
       help
       fingerprint  device.
source "drivers/input/fingerprints/goodix/Kconfig"
source "drivers/input/fingerprints/silead/Kconfig"
source "drivers/input/fingerprints/xiaomi_fp/Kconfig"
endmenu
```

## drivers/power/supply/lc_chg/Kconfig
```kconfig
# SPDX-License-Identifier: GPL-2.0
#charge_policy
source "drivers/power/supply/lc_chg/charger_policy/Kconfig"

#charger_ic
source "drivers/power/supply/lc_chg/charger_ic/Kconfig"

#protocol
source "drivers/power/supply/lc_chg/charger_ic/protocol/Kconfig"

#subpmic_sc6601a
source "drivers/power/supply/lc_chg/charger_ic/subpmic_sc6601a/Kconfig"

#subpmic_sy6976
source "drivers/power/supply/lc_chg/charger_ic/subpmic_sy6976/Kconfig"

#subpmic_nu6601
source "drivers/power/supply/lc_chg/charger_ic/subpmic_nu6601/Kconfig"

#chargepump
source "drivers/power/supply/lc_chg/charger_ic/chargepump/Kconfig"

#fuelgauge
source "drivers/power/supply/lc_chg/fuelgauge/Kconfig"

config LC_CHARGER_IC
	tristate "support lc charger ic"
	default n
	help
		Say Y here to support lc charger ic.

config LC_ADAPTER_CLASS
	tristate "support lc charger adapter class"
	default n
	help
		Say Y here to support lc charger adapter class.

config LC_CHARGER_CLASS
	tristate "support lc charger class"
	default n
	help
		Say Y here to support lc charger class.

config LC_CP_CLASS
	tristate "support lc chager pump class"
	default n
	help
		Say Y here to support lc chager pump class.

config LC_LED_CLASS
	tristate "support lc led calss"
	default n
	help
		Say Y here to support lc led calss.

config PD_BATTERY_SECRET
	tristate "pd battery secret"
	default n
	help
		Say Y here to support pd battery secret.

config XIAOMI_SMART_CHG
        tristate "support xiaomi smart charge"
        default n
        help
                Say Y here to support xiaomi smart charge.

config XM_CHG_ANIMATION
        tristate "support xiaomi charge animation"
        default n
        help
                Say Y here to support xiaomi charge animation.

config XM_FG_I2C_ERR
        tristate "support xiaomi fg i2c error"
        default n
        help
                Say Y here to support xiaomi fg i2c error.

config RUST_DETECTION
        tristate "support lc charger manager"
        default n
        help
                Say Y here to support lc charger class.

config LC_ADAPTIVE_POWEROFF_VOLTAGE
        tristate "support adaptive poweroff voltage strategy."
        default n
        help
                Say Y here to adaptive poweroff voltage strategy.
```

## drivers/power/supply/lc_chg/charger_ic/protocol/Kconfig
```kconfig
menuconfig PROTOCOL
	tristate "support protocol for southchip"
	help
	  Say Y here to support protocol.

if PROTOCOL

source "drivers/power/supply/lc_chg/charger_ic/protocol/bc12/Kconfig"

endif
```

## drivers/power/supply/lc_chg/charger_policy/Kconfig
```kconfig
#SPDX-License-Identifier: GPL-2.0

config LC_CHARGER_MANAGER
	tristate "support lc charger manger"
	default n
	help
		Say Y here to support lc charger manger.

config LC_CP_POLICY
	tristate "support lc charger pump policy"
	default n
	help
		Say Y here to support lc charger class.

config LC_QC_POLICY
	tristate "support lc qc policy"
	default n
	help
		Say Y here to support lc charger class.
```
